## rebuild/kernel/Documentation/devicetree/bindings/input/misc/yas537.txt
```
YAMAHA YAS537 3-axis electronic compass driver

Required properties:

 - compatible		: Should be "yamaha,yas537".
 - reg				: i2c address of the device.
 - vdd-supply		: Analog power supply needed to power up the device.
 - vio-supply		: Digital IO power supply needed for IO and I2C.

 Example:
	yamaha@2e {
		compatible = "yamaha,yas537";
		reg = <0x2e>;
		vdd-supply = <&pm8916_l17>;
		vio-supply = <&pm8916_l6>;
	};
```

## rebuild/kernel/drivers/input/touchscreen/mstar/Kconfig
```kconfig
#
# mstar touchscreen driver configuration
#
menuconfig TOUCHSCREEN_MSTAR_MSG22XX
	bool "Mstar touchscreen"
	default y
	help
	  Say Y here if you have a Synaptics DSX touchscreen connected
	  to your system.

	  If unsure, say N.

if TOUCHSCREEN_MSTAR_MSG22XX

config TOUCHSCREEN_MSTAR22XX
	tristate "mstar touchscreens"
	depends on I2C
	help
	  Say Y here if you have a mstar touchscreen.

	  If unsure, say N.

	  To compile this driver as a module, choose M here: the
	  module will be called msg22xx_ts.
endif
```
